## npc/Kconfig
```kconfig
mainmenu "NPC Configuration Menu"

choice
  prompt "Base ISA"
  default RVE

config RVE
  bool "RV32E"

config RVI
  bool "RV32I"
endchoice

menu "Simulation Options"

menuconfig DEVICE
  bool "Enable device model"
  default n

if DEVICE

config HAS_SERIAL
  bool "Enable serial"
  default y

config HAS_TIMER
  bool "Enable timer"
  default y

config HAS_KEYBOARD
  bool "Enable keyboard"
  default y

config HAS_VGA
  bool "Enable VGA"
  default y

if HAS_VGA

config VGA_SHOW_SCREEN
  bool "Enable SDL screen"
  default y

choice
  prompt "Screen size"
  default VGA_SIZE_400x300

config VGA_SIZE_400x300
  bool "400 x 300"

config VGA_SIZE_800x600
  bool "800 x 600"

endchoice

endif

config HAS_AUDIO
  bool "Enable audio"
  default y

if HAS_AUDIO

config SB_SIZE
  hex "Audio stream buffer size"
  default 0x200000

endif

endif

config PERFORMANCE_COUNTER
  bool "Enable performance counter"
  default n

endmenu

menu "ysyxSoC Options"

config FAST_FLASH
  bool "Enable fast flash model"
  default y

endmenu

menu "Trace and Debug Options"

config TRACE
  bool
  default y if ITRACE || MTRACE || FTRACE || DTRACE

config ITRACE
  bool "Enable instruction ring trace"
  default n

config MTRACE
  bool "Enable memory trace"
  default n

config FTRACE
  bool "Enable function trace"
  default n

config DTRACE
  bool "Enable device trace"
  depends on DEVICE
  default n

config WATCHPOINT
  bool "Enable watchpoint"
  default n

config DIFFTEST
  bool "Enable difftest"
  default n

config WAVE
  bool "Enable waveform dump"
  select VERILATOR_TRACE
  default n

endmenu

menu "Verilator Options"

config VERILATOR_TRACE
  bool "Build Verilator trace support"
  default WAVE

endmenu
```

## npc/configs/debug_defconfig
```kconfig
CONFIG_RVE=y
# CONFIG_RVI is not set
# CONFIG_DEVICE is not set
# CONFIG_DIFFTEST is not set
# CONFIG_PERFORMANCE_COUNTER is not set
CONFIG_WAVE=y
CONFIG_FAST_FLASH=y
CONFIG_ITRACE=y
# CONFIG_MTRACE is not set
# CONFIG_FTRACE is not set
CONFIG_WATCHPOINT=y
CONFIG_PC_RST_OFFSET=0x0
```

## npc/configs/fast_defconfig
```kconfig
CONFIG_RVE=y
# CONFIG_RVI is not set
# CONFIG_DEVICE is not set
# CONFIG_DIFFTEST is not set
# CONFIG_PERFORMANCE_COUNTER is not set
# CONFIG_WAVE is not set
CONFIG_FAST_FLASH=y
# CONFIG_ITRACE is not set
# CONFIG_MTRACE is not set
# CONFIG_FTRACE is not set
# CONFIG_WATCHPOINT is not set
# CONFIG_VERILATOR_TRACE is not set
```

## npc/configs/perf_defconfig
```kconfig
CONFIG_RVE=y
# CONFIG_RVI is not set
# CONFIG_DEVICE is not set
# CONFIG_DIFFTEST is not set
CONFIG_PERFORMANCE_COUNTER=y
# CONFIG_WAVE is not set
CONFIG_FAST_FLASH=y
# CONFIG_ITRACE is not set
# CONFIG_MTRACE is not set
# CONFIG_FTRACE is not set
# CONFIG_WATCHPOINT is not set
CONFIG_PC_RST_OFFSET=0x0
```
